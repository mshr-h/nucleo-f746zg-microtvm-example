static const char* graph_json = "{\"nodes\":[{\"op\":\"null\",\"name\":\"data\",\"inputs\":[]},{\"op\":\"null\",\"name\":\"p0\",\"inputs\":[]},{\"op\":\"tvm_op\",\"name\":\"fused_cast_subtract_cast\",\"attrs\":{\"num_outputs\":\"1\",\"num_inputs\":\"2\",\"flatten_data\":\"0\",\"func_name\":\"fused_cast_subtract_cast\",\"hash\":\"56af0eb601843dc6\"},\"inputs\":[[0,0,0],[1,0,0]]},{\"op\":\"null\",\"name\":\"p1\",\"inputs\":[]},{\"op\":\"null\",\"name\":\"p2\",\"inputs\":[]},{\"op\":\"tvm_op\",\"name\":\"fused_nn_conv2d_add_right_shift_cast\",\"attrs\":{\"num_outputs\":\"1\",\"num_inputs\":\"3\",\"flatten_data\":\"0\",\"func_name\":\"fused_nn_conv2d_add_right_shift_cast\",\"out_layout\":\"\",\"kernel_layout\":\"HWOI\",\"data_layout\":\"NHWC\",\"hash\":\"14c71675fc091908\"},\"inputs\":[[2,0,0],[3,0,0],[4,0,0]]},{\"op\":\"tvm_op\",\"name\":\"fused_nn_max_pool2d_cast_nn_relu_cast\",\"attrs\":{\"num_outputs\":\"1\",\"num_inputs\":\"1\",\"flatten_data\":\"0\",\"func_name\":\"fused_nn_max_pool2d_cast_nn_relu_cast\",\"layout\":\"NHWC\",\"hash\":\"1aa0609f7e8b7635\"},\"inputs\":[[5,0,0]]},{\"op\":\"null\",\"name\":\"p3\",\"inputs\":[]},{\"op\":\"null\",\"name\":\"p4\",\"inputs\":[]},{\"op\":\"tvm_op\",\"name\":\"fused_nn_conv2d_cast_add_cast_right_shift_cast_cast_nn_relu_cast\",\"attrs\":{\"num_outputs\":\"1\",\"num_inputs\":\"3\",\"flatten_data\":\"0\",\"func_name\":\"fused_nn_conv2d_cast_add_cast_right_shift_cast_cast_nn_relu_cast\",\"out_layout\":\"\",\"kernel_layout\":\"HWOI\",\"data_layout\":\"NHWC\",\"hash\":\"6b7f25ef32733906\"},\"inputs\":[[6,0,0],[7,0,0],[8,0,0]]},{\"op\":\"tvm_op\",\"name\":\"fused_nn_avg_pool2d_cast_1\",\"attrs\":{\"num_outputs\":\"1\",\"num_inputs\":\"1\",\"flatten_data\":\"0\",\"func_name\":\"fused_nn_avg_pool2d_cast_1\",\"layout\":\"NHWC\",\"hash\":\"cf30db3a6b1dc580\"},\"inputs\":[[9,0,0]]},{\"op\":\"null\",\"name\":\"p5\",\"inputs\":[]},{\"op\":\"null\",\"name\":\"p6\",\"inputs\":[]},{\"op\":\"tvm_op\",\"name\":\"fused_nn_conv2d_cast_add_cast_right_shift_cast_nn_relu_cast_cast\",\"attrs\":{\"num_outputs\":\"1\",\"num_inputs\":\"3\",\"flatten_data\":\"0\",\"func_name\":\"fused_nn_conv2d_cast_add_cast_right_shift_cast_nn_relu_cast_cast\",\"out_layout\":\"\",\"kernel_layout\":\"HWOI\",\"data_layout\":\"NHWC\",\"hash\":\"8a809b5d817b4d27\"},\"inputs\":[[10,0,0],[11,0,0],[12,0,0]]},{\"op\":\"tvm_op\",\"name\":\"fused_nn_avg_pool2d_cast\",\"attrs\":{\"num_outputs\":\"1\",\"num_inputs\":\"1\",\"flatten_data\":\"0\",\"func_name\":\"fused_nn_avg_pool2d_cast\",\"layout\":\"NHWC\",\"hash\":\"a2953fbf38fb96ae\"},\"inputs\":[[13,0,0]]},{\"op\":\"tvm_op\",\"name\":\"fused_nn_batch_flatten\",\"attrs\":{\"num_outputs\":\"1\",\"num_inputs\":\"1\",\"flatten_data\":\"0\",\"func_name\":\"fused_nn_batch_flatten\",\"hash\":\"04d23f8d7aac16c0\"},\"inputs\":[[14,0,0]]},{\"op\":\"null\",\"name\":\"p7\",\"inputs\":[]},{\"op\":\"null\",\"name\":\"p8\",\"inputs\":[]},{\"op\":\"tvm_op\",\"name\":\"fused_nn_contrib_dense_pack_add_cast_right_shift_cast\",\"attrs\":{\"num_outputs\":\"1\",\"num_inputs\":\"3\",\"flatten_data\":\"0\",\"func_name\":\"fused_nn_contrib_dense_pack_add_cast_right_shift_cast\",\"hash\":\"2262def019eb17cd\"},\"inputs\":[[15,0,0],[16,0,0],[17,0,0]]}],\"arg_nodes\":[0,1,3,4,7,8,11,12,16,17],\"heads\":[[18,0,0]],\"attrs\":{\"dltype\":[\"list_str\",[\"uint8\",\"int16\",\"int8\",\"int8\",\"int32\",\"int8\",\"int8\",\"int8\",\"int16\",\"int32\",\"int8\",\"int8\",\"int16\",\"int32\",\"int16\",\"int16\",\"int8\",\"int16\",\"int8\"]],\"storage_id\":[\"list_int\",[0,1,2,3,4,5,2,6,7,5,2,8,9,5,2,5,10,11,12]],\"shape\":[\"list_shape\",[[1,32,32,4],[1,32,32,4],[1,32,32,4],[5,5,32,4],[1,1,1,32],[1,32,32,32],[1,16,16,32],[5,5,32,32],[1,1,1,32],[1,16,16,32],[1,8,8,32],[5,5,64,32],[1,1,1,64],[1,8,8,64],[1,4,4,64],[1,1024],[1,1024,10],[10],[1,10]]]},\"node_row_ptr\":[0,1,2,3,4,5,6,7,8,9,10,11,12,13,14,15,16,17,18,19]}";
